/****************************************************************************

RickSynth
----------

MIT License

Copyright (c) [2021] [Richard Davies]

Permission is hereby granted, free of charge, to any person obtaining a copy
of this software and associated documentation files (the "Software"), to deal
in the Software without restriction, including without limitation the rights
to use, copy, modify, merge, publish, distribute, sublicense, and/or sell
copies of the Software, and to permit persons to whom the Software is
furnished to do so, subject to the following conditions:

The above copyright notice and this permission notice shall be included in all
copies or substantial portions of the Software.

THE SOFTWARE IS PROVIDED "AS IS", WITHOUT WARRANTY OF ANY KIND, EXPRESS OR
IMPLIED, INCLUDING BUT NOT LIMITED TO THE WARRANTIES OF MERCHANTABILITY,
FITNESS FOR A PARTICULAR PURPOSE AND NONINFRINGEMENT. IN NO EVENT SHALL THE
AUTHORS OR COPYRIGHT HOLDERS BE LIABLE FOR ANY CLAIM, DAMAGES OR OTHER
LIABILITY, WHETHER IN AN ACTION OF CONTRACT, TORT OR OTHERWISE, ARISING FROM,
OUT OF OR IN CONNECTION WITH THE SOFTWARE OR THE USE OR OTHER DEALINGS IN THE
SOFTWARE.
****************************************************************************/


#include "tim.h"

#include "_hw_info.h"

#include "common.h"

#include "clk.h"
#include "irq.h"


typedef struct
{
  bool init;
  TIM_HandleTypeDef hal;
  const tim_hw_info_t *hw;
} tim_handle_t;

typedef struct
{
  uint32_t count;
  ALARM_cfg_t cfg;
} alarm_handle_t;


static tim_handle_t handles[TIM_NUM_OF_CH] = {0};
static alarm_handle_t alarms[ALARM_NUM_OF_CH] = {0};

static uint32_t millis = 0;


static void decrementAlarms(void);
__attribute__((naked))
static void delay_loop (uint32_t loop_cnt __attribute__((unused)));


void TIM_initSystemTimer(void)
{
  /* 1ms systick */
  SysTick_Config(SystemCoreClock / 1000);
  irq_config(SysTick_IRQn, priority_VERY_LOW);
  irq_enable(SysTick_IRQn);
}


bool TIM_init(TIM_ch_e ch, TIM_cfg_t *cfg)
{
  return true;
}

bool TIM_start(TIM_ch_e ch)
{
  return true;
}

bool TIM_stop(TIM_ch_e ch)
{
  return true;
}


void      TIM_delayUs(uint32_t delay)
{
  uint64_t num_instructions;
  uint32_t n32;

  num_instructions = ((uint64_t)SystemCoreClock * delay) / 1000000;

  if (num_instructions > UINT32_MAX)
  {
    num_instructions = UINT32_MAX;
  }

  n32 = ((uint32_t)num_instructions >> 2);

  if (n32)
  {
    delay_loop(n32);
  }
}

void      TIM_delayMs(uint32_t delay)
{
  TIM_delayUs(delay * 1000);
}

uint32_t  TIM_millis(void)
{
  return millis;
}


bool ALARM_start(ALARM_ch_e ch, ALARM_cfg_t *cfg)
{
  bool ret = false;

  if (0 == alarms[ch].count)
  {
    alarms[ch].count = cfg->period_ms;
    memcpy(&alarms[ch].cfg, cfg, sizeof(ALARM_cfg_t));
    ret = true;
  }

  return ret;
}

void ALARM_stop(ALARM_ch_e ch)
{
  alarms[ch].count = 0;
}


static void decrementAlarms(void)
{
  ALARM_ch_e i;

  for (i = 0; i < ALARM_NUM_OF_CH; i++)
  {
    if (alarms[i].count)
    {
      --alarms[i].count;
      if (0 == alarms[i].count)
      {
        alarms[i].cfg.cb();

        if (alarms[i].cfg.repeat)
        {
          alarms[i].count = alarms[i].cfg.period_ms;
        }
      }
    }
  }
}

/* 4 instruction per loop + 2 for return
 * naked attribute removes prologue/ epilogue sequences generated by compiler */
__attribute__((naked))
static void delay_loop (uint32_t loop_cnt __attribute__((unused)))
{
  __asm volatile ("sw_delay_loop:         \n"
                  "   sub r0, r0, #1      \n"   ///< 1 cycle
                  "   cmp r0, #0          \n"   ///< 1 cycle
                  "   bne.n sw_delay_loop \n"   ///< 2 cycles
                  "   bx lr               \n"); ///< 2 cycles
}


void SysTick_Handler(void)
{
  ++millis;
  decrementAlarms();
  HAL_IncTick();
}
