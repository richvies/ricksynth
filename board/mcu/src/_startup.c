/****************************************************************************

RickSynth
----------

MIT License

Copyright (c) [2021] [Richard Davies]

Permission is hereby granted, free of charge, to any person obtaining a copy
of this software and associated documentation files (the "Software"), to deal
in the Software without restriction, including without limitation the rights
to use, copy, modify, merge, publish, distribute, sublicense, and/or sell
copies of the Software, and to permit persons to whom the Software is
furnished to do so, subject to the following conditions:

The above copyright notice and this permission notice shall be included in all
copies or substantial portions of the Software.

THE SOFTWARE IS PROVIDED "AS IS", WITHOUT WARRANTY OF ANY KIND, EXPRESS OR
IMPLIED, INCLUDING BUT NOT LIMITED TO THE WARRANTIES OF MERCHANTABILITY,
FITNESS FOR A PARTICULAR PURPOSE AND NONINFRINGEMENT. IN NO EVENT SHALL THE
AUTHORS OR COPYRIGHT HOLDERS BE LIABLE FOR ANY CLAIM, DAMAGES OR OTHER
LIABILITY, WHETHER IN AN ACTION OF CONTRACT, TORT OR OTHERWISE, ARISING FROM,
OUT OF OR IN CONNECTION WITH THE SOFTWARE OR THE USE OR OTHER DEALINGS IN THE
SOFTWARE.
****************************************************************************/


#include "_startup.h"

#include <stdint.h>

#include "_hw.h"
#include "tim.h"


/* Generated by linker. */
extern uint8_t _data_start_internal;
extern uint8_t _data_start;
extern uint8_t _data_end;
extern uint8_t _bss_start;
extern uint8_t _bss_end;

extern void (*_preinit_array_start[])(void);
extern void (*_preinit_array_end[])(void);
extern void (*_init_array_start[])(void);
extern void (*_init_array_end[])(void);
extern void (*_fini_array_start[])(void);
extern void (*_fini_array_end[])(void);


extern int main(void);


static void initData(uint8_t *from, uint8_t *start, uint8_t *end);
static void initBss(uint8_t *start, uint8_t *end);
static void runInitArray(void);
static void runFiniArray(void);


void start_resetHandler(void)
{
  /* reset to basic clock config for startup */
  hw_initEarly();

  /* copy data from flash to ram */
  initData(&_data_start_internal, &_data_start, &_data_end);
  initBss(&_bss_start, &_bss_end);

  /* init clocks fully */
  hw_init();

  /* run constructors */
  runInitArray();

  /* run main program */
  main();

  /* run deconstructors */
  runFiniArray();

  /* shouldn't ever get here so let watchdog reboot */
  while (1){};
}


static void initData(uint8_t *from, uint8_t *start, uint8_t *end)
{
  while (start < end)
  {
    *start++ = *from++;
  }
}

static void initBss(uint8_t *start, uint8_t *end)
{
  while (start < end)
  {
    *start++ = 0;
  }
}


static void runInitArray(void)
{
  uint32_t count;
  uint32_t i;

  count = _preinit_array_end - _preinit_array_start;
  for (i = 0; i < count; i++)
  {
    _preinit_array_start[i]();
  }

  count = _init_array_end - _init_array_start;
  for (i = 0; i < count; i++)
  {
    _init_array_start[i]();
  }
}

static void runFiniArray (void)
{
  uint32_t count;
  uint32_t i;

  count = _fini_array_end - _fini_array_start;
  for (i = count; i > 0; i--)
  {
    _fini_array_start[i - 1]();
  }
}
